## config/boards/shields/ergo_corne/Kconfig.shield
```kconfig
# Copyright (c) 2020 Pete Johanson
# SPDX-License-Identifier: MIT

config SHIELD_ERGO_CORNE_LEFT
    def_bool $(shields_list_contains,ergo_corne_left)

config SHIELD_ERGO_CORNE_RIGHT
    def_bool $(shields_list_contains,ergo_corne_right)
```
