## config/boards/shields/corne_dongle/Kconfig.defconfig
```kconfig
if SHIELD_CORNE_DONGLE_DONGLE

config ZMK_KEYBOARD_NAME
    default "Corne Dongle"

config ZMK_SPLIT_ROLE_CENTRAL
    default y

config ZMK_USB
    default y

endif

if SHIELD_CORNE_DONGLE_DONGLE || SHIELD_CORNE_DONGLE_LEFT || SHIELD_CORNE_DONGLE_RIGHT

config ZMK_SPLIT
    default y

endif
```

## config/boards/shields/corne_dongle/Kconfig.shield
```kconfig
# Copyright (c) 2020 Pete Johanson
# SPDX-License-Identifier: MIT

config SHIELD_CORNE_DONGLE_DONGLE
    def_bool $(shields_list_contains,corne_dongle_dongle)

config SHIELD_CORNE_DONGLE_LEFT
    def_bool $(shields_list_contains,corne_dongle_left)

config SHIELD_CORNE_DONGLE_RIGHT
    def_bool $(shields_list_contains,corne_dongle_right)
```

## config/boards/shields/dongle_display/Kconfig.shield
```kconfig
# Copyright (c) 2020 Pete Johanson
# SPDX-License-Identifier: MIT
config SHIELD_DONGLE_DISPLAY_VIEW_PRO_MICRO
    def_bool $(shields_list_contains,dongle_display_view_pro_micro)
```

## config/boards/shields/simple_temper/Kconfig.shield
```kconfig
# Copyright (c) 2020 Pete Johanson
# SPDX-License-Identifier: MIT

config SIMPLE_TEMPER_LEFT
    def_bool $(shields_list_contains,simple_temper_left)

config SIMPLE_TEMPER_RIGHT
    def_bool $(shields_list_contains,simple_temper_right)
```

## config/boards/shields/super_corne/Kconfig.shield
```kconfig
# Copyright (c) 2020 Pete Johanson
# SPDX-License-Identifier: MIT

config SHIELD_SUPER_CORNE_LEFT
    def_bool $(shields_list_contains,super_corne_left)

config SHIELD_SUPER_CORNE_RIGHT
    def_bool $(shields_list_contains,super_corne_right)
    

config SHIELD_SUPER_CORNE_DONGLE
    def_bool $(shields_list_contains,super_corne_dongle)
```

## config/boards/shields/temper/Kconfig.shield
```kconfig
# Copyright (c) 2020 Pete Johanson
# SPDX-License-Identifier: MIT

config SHIELD_TEMPER_LEFT
    def_bool $(shields_list_contains,temper_left)

config SHIELD_TEMPER_RIGHT
    def_bool $(shields_list_contains,temper_right)

config SHIELD_TEMPER_DONGLE
    def_bool $(shields_list_contains,temper_dongle)

config SHIELD_DONGLE_DISPLAY_VIEW_PRO_MICRO
    def_bool $(shields_list_contains,dongle_display_view_pro_micro)
```
